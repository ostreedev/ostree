## gnomeos/yocto/conf/distro/gnomeosdistro.conf
```bitbake
DISTRO = "gnomeosdistro"
DISTRO_NAME = "GNOME OS (Poky 6.0+ostree)"
DISTRO_VERSION = "0+snapshot-${DATE}"
SDK_VENDOR = "-gnomesdk"
SDK_VERSION := "${@'${DISTRO_VERSION}'.replace('snapshot-${DATE}','snapshot')}"

MAINTAINER = "Colin Walters <walters@verbum.org>"

TARGET_VENDOR = "-gnomeos"

SYSVINIT_ENABLED_GETTYS = "1 2 3 4 5 6"

LOCALCONF_VERSION = "1"

DISTRO_FEATURES_append = " largefile opengl pam"

PREFERRED_VERSION_linux-yocto ?= "3.0.%"
PREFERRED_VERSION_linux-yocto_qemux86 ?= "3.0%"
PREFERRED_VERSION_linux-yocto_qemux86-64 ?= "3.0%"

SDK_NAME = "${DISTRO}-${TCLIBC}-${SDK_ARCH}-${TARGET_ARCH}"
SDKPATH = "/opt/${DISTRO}/${SDK_VERSION}"

DISTRO_EXTRA_RDEPENDS += "task-core-boot"
DISTRO_EXTRA_RRECOMMENDS += "kernel-module-af-packet"

QEMU_TARGETS ?= "i386 x86_64"

PREMIRRORS ?= "\
bzr://.*/.*   http://autobuilder.yoctoproject.org/sources/ \n \
cvs://.*/.*   http://autobuilder.yoctoproject.org/sources/ \n \
git://.*/.*   http://autobuilder.yoctoproject.org/sources/ \n \
hg://.*/.*    http://autobuilder.yoctoproject.org/sources/ \n \
osc://.*/.*   http://autobuilder.yoctoproject.org/sources/ \n \
p4://.*/.*    http://autobuilder.yoctoproject.org/sources/ \n \
svk://.*/.*   http://autobuilder.yoctoproject.org/sources/ \n \
svn://.*/.*   http://autobuilder.yoctoproject.org/sources/ \n"

MIRRORS =+ "\
ftp://.*/.*      http://autobuilder.yoctoproject.org/sources/ \n \
http://.*/.*     http://autobuilder.yoctoproject.org/sources/ \n \
https://.*/.*    http://autobuilder.yoctoproject.org/sources/ \n"

# The CONNECTIVITY_CHECK_URI's are used to test whether we can succesfully
# fetch from the network (and warn you if not). To disable the test set
# the variable to be empty.
CONNECTIVITY_CHECK_URIS ?= "git://git.yoctoproject.org/yocto-firewall-test;protocol=git;rev=HEAD \
                          https://eula-downloads.yoctoproject.org/index.php \
                          http://bugzilla.yoctoproject.org/report.cgi"
```

## gnomeos/yocto/conf/layer.conf
```bitbake
BBPATH := "${BBPATH}:${LAYERDIR}"

BBFILES := "${BBFILES} ${LAYERDIR}/packages/*/*.bb ${LAYERDIR}/recipies-*/*/*.bb" 

BBFILE_COLLECTIONS += "gnomeos"
BBFILE_PATTERN_gnomeos := "^${LAYERDIR}/"
BBFILE_PRIORITY_gnomeos = "6"
```
